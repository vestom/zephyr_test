## CMakeLists.txt
```
# SPDX-License-Identifier: Apache-2.0

cmake_minimum_required(VERSION 3.13.1)

include($ENV{ZEPHYR_BASE}/cmake/app/boilerplate.cmake NO_POLICY_SCOPE)
project(ztest)


target_include_directories(app PRIVATE include)
target_include_directories(app PRIVATE src)

# TinyFramework
set(TF_TARGET app)
add_subdirectory(modules/TinyFramework)


target_sources(app PRIVATE src/main.cpp)
```

## prj.conf
```kconfig
# C++  Ensure constructors are called etc.
CONFIG_CPLUSPLUS=y

# Enable devices
CONFIG_UART_INTERRUPT_DRIVEN=y
#   UART_1 on stm32f4_disco = TX: PB6, RX: PB7

# Enable uart console
#   UART_1 on stm32_min_dev_blue = TX: PA9, RX: PA10
#   UART_2 on stm32f4_disco = TX: PA2, RX: PA3
CONFIG_CONSOLE=y
CONFIG_CONSOLE_SUBSYS=y
CONFIG_CONSOLE_GETCHAR=y

# Semihosting console
#CONFIG_UART_CONSOLE=n
#CONFIG_SEMIHOST_CONSOLE=y

# USB console - Uncomment all to enable
#CONFIG_USB=y
#CONFIG_USB_DEVICE_STACK=y
#CONFIG_USB_DEVICE_PRODUCT="Zephyr USB console"
#CONFIG_USB_UART_CONSOLE=y
#CONFIG_UART_CONSOLE_ON_DEV_NAME="CDC_ACM_0"
#CONFIG_UART_LINE_CTRL=y
#CONFIG_USB_UART_DTR_WAIT=y


# Use k_malloc/k_free (needed for using malloc in TF)
#CONFIG_HEAP_MEM_POOL_SIZE=1024
# Use malloc from minimal libc
CONFIG_MINIMAL_LIBC_MALLOC_ARENA_SIZE=1024

# SystemView
#CONFIG_THREAD_NAME=y
#CONFIG_SEGGER_SYSTEMVIEW=y
#CONFIG_USE_SEGGER_RTT=y

#CONFIG_DEBUG_OPTIMIZATIONS=y
#CONFIG_ASSERT=y

#CONFIG_TRACING_CPU_STATS=y
#CONFIG_STACK_USAGE=y
```

## prj_native_posix_64.conf
```kconfig
# Ensure constructors are called etc.
#CONFIG_CPLUSPLUS=y

## Notes
# - main() must be declared extern "C" or it will not be called.
# - If CONFIG_CPLUSPLUS is set, the constructors will be called twice (from app and init.c).
```

## src/main.cpp
```c
#include <stdio.h>
#include <string.h>

#include "TF/TF.h"
#include "TF/Log.h"
#include "TF/Serial.h"
#include "TF/Thread.h"
#include "TF/Time.h"
#include "TF/GPIO.h"

#ifdef __ZEPHYR__
#include <zephyr.h>
K_THREAD_STACK_DEFINE(stack_1, 1024);
K_THREAD_STACK_DEFINE(stack_2, 1024);
#endif

//#include "MyClass.hpp"
TF::TimeStamp   maxThreadRunTime=0;     // Ugly global for test...
#include "SerialThread.hpp"
#include "ConsoleThread.hpp"

SerialThread    serialThread;
ConsoleThread   consoleThread;

// STM32F103 Bluepill
//#define LED0_PORT   "GPIOC"
//#define LED0_PIN    13
// Devicetree
#define LED0_PORT   DT_GPIO_LABEL(DT_ALIAS(led0), gpios)
#define LED0_PIN    DT_GPIO_PIN(DT_ALIAS(led0), gpios)

auto gpio_led = TF::GPIO(LED0_PORT, LED0_PIN);

//int main()
extern "C" int main()
{
    TF::Log::setLogDebug(false);
    printf("Build: %s %s\n", __DATE__, __TIME__);

    printf("LED0 Port: %s, Pin: %i\n", DT_GPIO_LABEL(DT_ALIAS(led0), gpios), DT_GPIO_PIN(DT_ALIAS(led0), gpios));
//    printf("LED2 Port: %s, Pin: %i\n", DT_GPIO_LABEL(DT_ALIAS(led2), gpios), DT_GPIO_PIN(DT_ALIAS(led2), gpios));

#ifdef __ZEPHYR__
    memset(stack_1, 0xA5, K_THREAD_STACK_SIZEOF(stack_1));  // Fill for debug
    memset(stack_2, 0xA5, K_THREAD_STACK_SIZEOF(stack_2));  // Fill for debug
    printf("stack_1 %p size: %u\n", stack_1, K_THREAD_STACK_SIZEOF(stack_1));
    printf("stack_2 %p size: %u\n", stack_2, K_THREAD_STACK_SIZEOF(stack_2));
    serialThread.start(stack_1, K_THREAD_STACK_SIZEOF(stack_1));  //, TF::Thread::Priority::HIGH);
    consoleThread.start(stack_2, K_THREAD_STACK_SIZEOF(stack_2));
#else
    serialThread.start();
    consoleThread.start();
#endif

/////////// Benchmark
    TF::Time tic;
    char s[100];
    for (int n=0; n<1000; n++) {
        sprintf(s, "Print med format %u\n",n);
    }
    auto elapsed = tic.get_elapsed_ms();
    printf("%s", s);
    printf("Time: %lu ms\n", elapsed);
//////////

    while(1) {
        gpio_led.set(!gpio_led.get());
        if(consoleThread.event.is_set())  {
            consoleThread.event.wait();
            printf("Got event!\n");
        }
        TF::Thread::sleep_ms(300);
    }

    return 0;
}
```

## src/ConsoleThread.hpp
```c
#include "TF/Log.h"
#include "TF/Thread.h"
#include "TF/Time.h"
#include "TF/Event.h"
#include "TF/Mutex.h"
#include "TF/Zephyr/zephyr_extras.h"
#include <string.h>
#include <console/console.h>
#include <stdlib.h>
#include <ctype.h>

// Use of tracing require a Zephyr fix to declare functions 'extern "C" {}'
#include <tracing/tracing.h>

//// Helpers Begin

// Pretty print of a block of memory
void printMem(void *p, size_t s) {
    static const int WIDTH = 32;
    int row=0, col=0, columns;
    int rows = (s+WIDTH-1)/WIDTH;   // Round up
    char c;
    for(row=0; row<rows; row++) {
        printf("*%10p : ", (char*)p+row*WIDTH);
        columns = MIN(WIDTH, s-row*WIDTH);
        for (col=0; col<columns; ++col) {
            printf("%02X", ((char*)p)[row*WIDTH+col]);
        }
        printf(" [");
        for (col=0; col<columns; ++col) {
            c = ((char*)p)[row*WIDTH+col];
            c = (isprint(c) ? c : '.');
            printf("%c", c);
        }
        printf("]\n");
    }
}

// Test if string starts with pre string
// Returns pointer to next character or NULL if not found
const char * startsWith(const char *str, const char *pre) {
    while(*pre) {
        if(*pre++ != *str++)
            return NULL;
    }
    return str;
}

// Return pointer to next parameter delimited by whitespace or '/'
const char * findNextParm(const char *str) {
    while(*str) {   // Find first delimiter
        if(isspace(*str) || *str=='/') {
            str++;  // Skip delimiter
            break;
        }
        str++;
    }
    while(isspace(*str)) { str++; } // Skip extra whitespace
    if(*str)    return str;
    else        return NULL;
}

//// Helpers End

class ConsoleThread : public TF::Thread {
public:
    TF::Event event;
    TF::Mutex printMutex;

private:
    char str_input[32];     // Object variable to hold string to parse

    void run() {
        TF::Log::debug("ConsoleThread");
        console_init();
        const char *s;

        while(1) {
            fgets(str_input, sizeof(str_input), stdin);
            printMutex.lock();
            printf("*%s", str_input);
            if         (startsWith(str_input, "cl"))  { cmdCpuLoad(); }
            else if    (startsWith(str_input, "cs"))  { cmdCpuStats(); }
            else if    (startsWith(str_input, "d"))   { cmdDebug(); }
            else if    (startsWith(str_input, "e"))   { cmdEvent(); }
            else if    (startsWith(str_input, "h"))   { cmdHelp(); }
            else if ((s=startsWith(str_input, "md"))) { cmdMemDisplay(s); }
            else if ((s=startsWith(str_input, "mt"))) { cmdMemTest(s); }
            else if    (startsWith(str_input, "s"))   { cmdStatistics(); }
            else if ((s=startsWith(str_input, "t")))  { cmdTest(s); }
            else    { printf("*Error! 'h' for help\n"); }
            printMutex.unlock();
        }
    }

    void cmdHelp() {
        printf("*Console commands:\n");
        printf("* cl = Load CPU for 1 sec\n");
        printf("* cs = CPU stats\n");
        printf("* d = Debug on/off\n");
        printf("* e = Event\n");
        printf("* h = Help\n");
        printf("* md <addr> [<size>] = Display memory\n");
        printf("* mt <size> = Test memory allocation\n");
        printf("* s = Thread statistics\n");
        printf("* t <parm> = Test\n");
    }

    void cmdCpuLoad() {
        volatile int i=0;
        TF::Time time(1000);
        printf("*Loading CPU... ");
        while(!time.is_expired()) { i++; }
        printf("*Done!\n");
    }

    void cmdCpuStats() {
/* This function only works with C++ fix in zephyr
        struct cpu_stats stats;
        cpu_stats_get_ns(&stats);
        uint64_t allticks = (stats.idle+stats.sched+stats.non_idle);
        uint64_t l_idle   = 1000ULL * (stats.idle) / allticks;
        uint64_t l_nidle  = 1000ULL * (stats.non_idle) / allticks;
        uint64_t l_sched  = 1000ULL * (stats.sched) / allticks;
//        printf("*CPU stats: Idle %u, Non-Idle %u, Sched %u\n",
//            (unsigned)stats.idle, (unsigned)stats.non_idle, (unsigned)stats.sched);
        printf("*CPU stats: Idle %.1f %%, Non-Idle %.1f %%, Sched %.1f %%\n",
            0.1*l_idle, 0.1*l_nidle, 0.1*l_sched);
        cpu_stats_reset_counters();
*/
    }

    void cmdDebug() {
        bool newstate = !TF::Log::getLogDebug();
        printf("*Debug %s\n", (newstate ? "Enabled" : "Disabled"));
        TF::Log::setLogDebug(newstate);
    }

    void cmdEvent() {
        event.set();
    }

    void cmdMemDisplay(const char *param) {
        char *str;
        void* p = (void*)strtoul(param, &str, 0); // Get address
        size_t s = strtoul(str, &str, 0);   // Get size
        s = (s ? s : 256);  // Default size
        printf("*Memory @ %p, size: %u...\n", p, s);
        printMem(p, s);
    }

    class Test {
    public:
        Test() { printf("* %s\n", __PRETTY_FUNCTION__); }
        ~Test() { printf("* %s\n", __PRETTY_FUNCTION__); }
        char str[64];
    };

    void cmdMemTest(const char *param) {
        int size = atoi(param);
        printf("*Allocating %i bytes...\n", size);
        char* str = (char*) malloc(size);
        if(!str) printf("* malloc(%i) failed!\n", size);
        free(str);
        Test *p = new Test;
        delete p;
    }

    void cmdStatistics(void) {
        printf("*Thread max run time\n");
        printf("*  SerialThread = %lu ms\n", maxThreadRunTime);
    }

    void cmdTest(const char *param) {
        printf("*Received param: %s\n", param);
        const char str[] = "*Test print of long sentence..\n";
//        size_t len = sizeof(str);
        TF::Time time(0);
        printf(str);
//        console_write(NULL, str, len);
        unsigned elapsed = time.get_elapsed_ms();
        printf("*Time spent: %u ms\n", elapsed);
    }
};
```

## src/MyClass.hpp
```c
#include <stdio.h>

class MyClass {
public:
    MyClass() {
        printf("MyClass()\n");
    }

    void test() {
        printf("MyClass.test()\n");
    }
};
```

## src/SerialThread.hpp
```c
#include "TF/Log.h"
#include "TF/Serial.h"
#include "TF/Thread.h"
#include "TF/Time.h"
#include <string.h>

#define LED2_PORT   DT_GPIO_LABEL(DT_ALIAS(led2), gpios)
#define LED2_PIN    DT_GPIO_PIN(DT_ALIAS(led2), gpios)
#define SERIAL_UART "UART_1"

class SerialThread : public TF::Thread {
    void run() {
        char tx_buffer[32];
        char rx_buffer[32];
        char str[32];
        int n=0;

        TF::Log::debug("SerialThread");

        if(!serial.open(SERIAL_UART, 115200)) {
            TF::Log::error("Could not open Serial port - Exiting!");
            return;
        }
        serial.flushRxBuffer();

        auto gpio_led = TF::GPIO(LED2_PORT, LED2_PIN);

        run_period.set_timeout_ms(100);  // 10Hz
        run_period.reset();

        while(1) {
            // Periodic loop
            maxThreadRunTime = MAX(maxThreadRunTime, run_period.get_elapsed_ms());
            while(run_period.get_remaining_ms() > 0) {
                TF::Thread::sleep_ms(run_period.get_remaining_ms());
            }
            run_period.reset();

            gpio_led.set(!gpio_led.get());

            // RX
            int bytes = serial.getRxBytes();
            if(bytes) {
                serial.read((uint8_t *)rx_buffer, bytes);
                rx_buffer[bytes] = 0;   // safe string termination..

                // Bin2Hex
                for (int n=0; n<bytes; ++n) {
                    snprintf(str+n*2, sizeof(str)-n*2, "%02X ", (unsigned)rx_buffer[n]);
                }
                //TF::Log::debug("Received: %s, [%u] %s", rx_buffer, bytes, str);
                TF::Log::debug("Received: %s, [%u]", rx_buffer, bytes);
            }

            // TX
            snprintf(tx_buffer, sizeof(tx_buffer), "Test %2i\n", n++);
            //TF::Log::debug("Sending: %s", tx_buffer);
            serial.write((uint8_t*) tx_buffer, strlen(tx_buffer));
        }
        // Test queue
//      queue.send((uint8_t*)"MSG1", 256);
//      queue.send((uint8_t*)"MSG2", 8);
    }

    TF::Serial serial;
    TF::Time run_period;

#if 0
//#ifdef __linux__
    public:
        void operator delete(void* v) {};
#endif
};
```

## src/TF_Config.h
```c
// Template file for configuring TinyFramework
// Tailor and rename to TF_Config.h and ensure it is within compiler include path

// Zephyr: Enable dynamic memory support
// Needs CONFIG_HEAP_MEM_POOL_SIZE=XXX set in Zephyr project
//#define TF_ZEPHYR_DYNAMIC_MEMORY
// Zephyr: Enable debug printouts when using dynamic memory
//#define TF_DEBUG_ZEPHYR_DYNAMIC_MEMORY
```
